## conf/bblayers.conf
```bitbake
# POKY_BBLAYERS_CONF_VERSION is increased each time build/conf/bblayers.conf
# changes incompatibly
POKY_BBLAYERS_CONF_VERSION = "2"

BBPATH = "${TOPDIR}"
BBFILES ?= ""

BBLAYERS ?= " \
  /home/pokrov/Projects/yocto/poky/meta \
  /home/pokrov/Projects/yocto/poky/meta-poky \
  /home/pokrov/Projects/yocto/poky/meta-openembedded/meta-oe \
  /home/pokrov/Projects/yocto/poky/meta-openembedded/meta-multimedia \
  /home/pokrov/Projects/yocto/poky/meta-openembedded/meta-networking \
  /home/pokrov/Projects/yocto/poky/meta-openembedded/meta-python \
  /home/pokrov/Projects/yocto/poky/meta-raspberrypi \
  /home/pokrov/Projects/yocto/poky/meta-qt5 \
  /home/pokrov/Projects/yocto/poky/meta-mylayer \
  "
```

## conf/local.conf
```bitbake
#local.conf

#MACHINE ?= "qemux86"
#MACHINE ?= "genericx86"
MACHINE ?= "raspberrypi3"


# -- RASPBERRY SPECIALS --
# Disable delay on boot
BOOT_DELAY = "0"
BOOT_DELAY_MS = "0"
# Disable frame
DISABLE_OVERSCAN = "1"
# Disable special rpi logo and rainbow
DISABLE_RPI_BOOT_LOGO = "1"
DISABLE_SPLASH = "1"
# Use waveshare 1024x600 7-inch display
WAVESHARE_1024X600_C_2_1 = "1"


DISTRO_FEATURES_remove = "x11 wayland"
MACHINE_FEATURES_remove = "bluetooth"

IMAGE_INSTALL_remove = "eglinfo-x11"
IMAGE_INSTALL_append = "psplash"

IMAGE_BOOTLOADER = "barebox"

DISTRO ?= "poky"
PACKAGE_CLASSES ?= "package_rpm"
#SDKMACHINE ?= "i686"

EXTRA_IMAGE_FEATURES ?= "debug-tweaks"
USER_CLASSES ?= "buildstats image-mklibs image-prelink"
PATCHRESOLVE = "noop"
```

## example/conf/local.conf
```bitbake
# local.conf

#MACHINE ?= "genericx86"
MACHINE ?= "raspberrypi3"


# -- RASPBERRY SPECIALS --
# Disable delay on boot
BOOT_DELAY = "0"
BOOT_DELAY_MS = "0"
# Disable frame
DISABLE_OVERSCAN = "1"
# Disable special rpi logo and rainbow
DISABLE_RPI_BOOT_LOGO = "1"
DISABLE_SPLASH = "1"
# Use waveshare 1024x600 7-inch display
WAVESHARE_1024X600_C_2_1 = "1"

# remove x11
DISTRO_FEATURES_remove = "x11 wayland"
IMAGE_INSTALL_remove = "eglinfo-x11"
# remove bluez
MACHINE_FEATURES_remove = "bluetooth"

# set our own boot image
IMAGE_INSTALL_append = "psplash"

# disable selecting mode for legacy bios
AUTO_SYSLINUXMENU = "0"



DISTRO ?= "poky"
PACKAGE_CLASSES ?= "package_rpm"
#SDKMACHINE ?= "i686"

EXTRA_IMAGE_FEATURES ?= "debug-tweaks"
USER_CLASSES ?= "buildstats image-mklibs image-prelink"
PATCHRESOLVE = "noop"
```
